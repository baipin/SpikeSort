## esp32s3-bandwidth-sender/main/Kconfig.projbuild
```kconfig
menu "Bandwidth Sender"

    config BANDWIDTH_WIFI_SSID
        string "WiFi SSID"
        default "YOUR_HOTSPOT_SSID"
        help
            WiFi network used by the ESP32-S3 bandwidth sender.

    config BANDWIDTH_WIFI_PASSWORD
        string "WiFi password"
        default "YOUR_HOTSPOT_PASSWORD"
        help
            Password for the WiFi network.

    choice BANDWIDTH_TRANSPORT
        prompt "Transport protocol"
        default BANDWIDTH_TRANSPORT_TCP
        help
            Select TCP for reliable byte-stream testing or UDP for packet-loss and maximum-throughput testing.

        config BANDWIDTH_TRANSPORT_TCP
            bool "TCP"

        config BANDWIDTH_TRANSPORT_UDP
            bool "UDP"
    endchoice

    config BANDWIDTH_SERVER_IP
        string "Receiver IPv4 address"
        default "192.168.137.1"
        help
            Laptop IP address reachable from the ESP32-S3.

    config BANDWIDTH_SERVER_PORT
        int "Receiver port"
        default 5001
        range 1 65535
        help
            TCP or UDP port listened on by the laptop receiver.

    config BANDWIDTH_PAYLOAD_BYTES
        int "Payload bytes per frame"
        default 4096
        range 1 65535
        help
            Binary payload size appended after the 12-byte frame header.

    config BANDWIDTH_FPS
        int "Frames per second"
        default 20
        range 1 5000
        help
            Target frame cadence for the sender task.

    config BANDWIDTH_UNLIMITED_SEND
        bool "Send as fast as possible"
        default n
        help
            Disable frame pacing and send the next frame immediately after the previous send call returns. Use this for
            UDP maximum-throughput experiments instead of controlled-FPS sweeps.

    config BANDWIDTH_PRECISE_PACING
        bool "Use microsecond-level pacing for high FPS streams"
        default n
        help
            Use esp_timer/ROM microsecond waits for sub-tick frame intervals. This is useful when the target frame
            interval is below the FreeRTOS tick period, for example 1500 fps is about 667 us between frames.

    config BANDWIDTH_DROP_LATE_FRAMES
        bool "Drop overdue paced frames instead of catching up in a burst"
        default n
        depends on !BANDWIDTH_UNLIMITED_SEND
        help
            When a paced sender is late because the WiFi/lwIP path blocked a send, skip stale frame slots rather
            than immediately sending the accumulated backlog. This preserves data freshness for real-time streams.

    config BANDWIDTH_MAX_LATE_FRAMES
        int "Allowed paced-frame lateness before dropping"
        default 1
        range 0 1000
        depends on BANDWIDTH_DROP_LATE_FRAMES
        help
            Number of frame intervals that may be late before stale scheduled frames are skipped.

    config BANDWIDTH_SEND_TIMEOUT_MS
        int "Per-frame send timeout in milliseconds"
        default 100
        range 1 10000
        help
            Drop the current application frame if non-blocking send cannot finish in this time.

    config BANDWIDTH_TEST_DURATION_S
        int "Finite sender test duration in seconds"
        default 0
        range 0 86400
        help
            Stop the sender after this many seconds and export successful-send records. Zero keeps the sender running
            indefinitely. Use a finite value when an exact sender success sequence set is required.

    config BANDWIDTH_RECORD_SEND_SUCCESSES
        bool "Record successful UDP sends in RAM"
        default n
        depends on BANDWIDTH_TRANSPORT_UDP
        help
            Keep send_ok_ts_us and seq for every successful UDP send until the finite test ends. This requires enough
            RAM/PSRAM and is intended for controlled offline loss validation.

    config BANDWIDTH_SEND_RECORD_CAPACITY
        int "Maximum successful-send records"
        default 1000000
        range 1 4000000
        depends on BANDWIDTH_RECORD_SEND_SUCCESSES
        help
            Maximum number of send-success records retained before an overflow counter is raised.

    config BANDWIDTH_SOCKET_SNDBUF
        int "Socket send buffer bytes"
        default 16384
        range 0 1048576
        help
            Requested SO_SNDBUF size for the selected transport. Set 0 to keep the lwIP default.

    config BANDWIDTH_TCP_BLOCKING_SEND
        bool "Use blocking TCP send"
        default n
        depends on BANDWIDTH_TRANSPORT_TCP
        help
            Keep the TCP socket in blocking mode and let lwIP apply backpressure directly. This can reduce explicit
            1 ms retry sleeps in high-rate TCP tests, at the cost of making each send call potentially block.

    config BANDWIDTH_TCP_NODELAY
        bool "Disable TCP Nagle algorithm"
        default n
        depends on BANDWIDTH_TRANSPORT_TCP
        help
            Set TCP_NODELAY on the TCP socket. This is mainly useful for small frames; for near-MTU frames it is a
            diagnostic switch to verify whether sender-side coalescing contributes to burstiness.

    config BANDWIDTH_TCP_BATCH_FRAMES
        int "TCP application frames per send call"
        default 1
        range 1 32
        depends on BANDWIDTH_TRANSPORT_TCP
        help
            Pack multiple application frames into one TCP write while keeping the receiver frame format unchanged.
            This reduces socket-call pressure for high-frame-rate TCP diagnostics.

    config BANDWIDTH_UDP_BLOCKING_FAST_SEND
        bool "Use blocking UDP send"
        default y
        depends on BANDWIDTH_TRANSPORT_UDP
        help
            Keep the UDP socket in blocking mode for throughput-oriented tests. When lwIP temporarily reports
            EAGAIN/ENOBUFS, the sender waits for the socket to become writable again instead of forcing the frame
            into a full local buffer. This follows the official ESP-IDF iperf transmit pattern more closely than the
            diagnostic non-blocking send-with-timeout loop and can reduce sender-side burstiness and drops.

    config BANDWIDTH_UNLIMITED_YIELD_EVERY_N_FRAMES
        int "Yield interval for unlimited-send mode"
        default 0
        range 0 1000000
        help
            In unlimited-send experiments, yield once after this many successfully scheduled application frames.
            Set 0 to disable. A small periodic yield keeps WiFi, lwIP, idle, and watchdog housekeeping responsive
            during long detached saturated UDP traces.

    config BANDWIDTH_UNLIMITED_DELAY_EVERY_N_FRAMES
        int "Delay interval for unlimited-send mode"
        default 0
        range 0 1000000
        help
            In unlimited-send experiments, delay for one FreeRTOS tick after this many successfully scheduled
            application frames. Set 0 to disable. This is stronger than a task yield and is useful for long
            battery/power-bank field traces where a pure tight loop may starve housekeeping tasks.

    config BANDWIDTH_WIFI_PS_NONE
        bool "Disable WiFi power save"
        default n
        help
            Disable station modem sleep for maximum-throughput diagnostics.

    config BANDWIDTH_WIFI_11N_ONLY
        bool "Force WiFi station protocol to 802.11n"
        default n
        help
            Restrict the station protocol bitmap to 802.11n for HT throughput diagnostics. Use only with an AP/hotspot
            that supports 802.11n.

    config BANDWIDTH_WIFI_11GN_ONLY
        bool "Disable 802.11b and keep 802.11g/n"
        default n
        help
            Use 802.11g/n on 2.4 GHz while removing 802.11b rates. This keeps compatibility with APs that dislike an
            802.11n-only association while still avoiding legacy 11b behavior.

    config BANDWIDTH_WIFI_HT40
        bool "Request 802.11n HT40 channel width"
        default n
        help
            Request 40 MHz 802.11n channel width for throughput diagnostics. The AP/hotspot and local regulatory
            conditions may still force HT20.

    config BANDWIDTH_LOG_DROPPED_FRAMES
        bool "Log each dropped frame"
        default y
        help
            Print one warning per sender-side dropped frame. Disable for high-rate UDP diagnostics to reduce logging overhead.

    config BANDWIDTH_LOG_STATS
        bool "Log sender stats once per second"
        default y
        help
            Print one per-second sender stats line. Disable during short-window throughput experiments to avoid
            periodic serial logging work from appearing as a one-second cadence artifact.

    config BANDWIDTH_DIAG_STATIC_PAYLOAD
        bool "Diagnostic: keep payload bytes static"
        default n
        help
            Fill payload bytes once and only update the frame header for each send. This isolates payload-generation cost.

    config BANDWIDTH_DIAG_DISABLE_CRC
        bool "Diagnostic: disable per-frame CRC calculation"
        default n
        help
            Write a zero CRC field instead of calculating CRC16. Only use with a receiver that skips CRC validation.

    config BANDWIDTH_50MS_TELEMETRY
        bool "Embed sender 50 ms telemetry in UDP frames"
        default y
        help
            Embed sender offered, successful-send, and dropped counters in each UDP payload.

    config BANDWIDTH_EXTENDED_TELEMETRY
        bool "Embed extended sender diagnostics in UDP frames"
        default y
        help
            Reuse the first 52 payload bytes to carry a versioned sender diagnostic snapshot: 50 ms counters,
            backpressure counters, fatal-send count, last errno, free heap, and sender uptime. This does not change
            the configured datagram size or add serial output per packet. Disable only when preserving the old payload
            contents is required.

    config BANDWIDTH_SNTP_ENABLE
        bool "Enable SNTP clock sync"
        default y
        help
            Synchronize ESP32-S3 system time before streaming so the receiver can estimate end-to-end latency.

    config BANDWIDTH_SNTP_SERVER
        string "SNTP server"
        default "pool.ntp.org"
        depends on BANDWIDTH_SNTP_ENABLE
        help
            NTP/SNTP server used for ESP32-S3 wall-clock synchronization.

    config BANDWIDTH_SNTP_SYNC_TIMEOUT_MS
        int "SNTP sync timeout in milliseconds"
        default 60000
        range 1000 120000
        depends on BANDWIDTH_SNTP_ENABLE
        help
            Maximum time to wait for SNTP synchronization before retrying or, when SNTP is not required, falling
            back to monotonic uptime timestamps.

    config BANDWIDTH_REQUIRE_SNTP
        bool "Require SNTP before streaming"
        default y
        depends on BANDWIDTH_SNTP_ENABLE
        help
            Keep retrying SNTP synchronization before sending frames. This prevents formal latency experiments from
            silently falling back to monotonic timestamps, which cannot be used for receiver-side latency estimates.

endmenu
```

## esp32s3-bandwidth-sender/sdkconfig.defaults.udp_1k_100fps
```kconfig
# CPU frequency
CONFIG_ESP_DEFAULT_CPU_FREQ_MHZ_240=y

# Flash / PSRAM. Adjust these for boards that are not N8R8.
CONFIG_ESPTOOLPY_FLASHSIZE_8MB=y
CONFIG_SPIRAM=y
CONFIG_SPIRAM_MODE_OCT=y

# FreeRTOS 1 ms tick
CONFIG_FREERTOS_HZ=1000

# SNTP
CONFIG_LWIP_SNTP_MAX_SERVERS=3

# UDP bandwidth sender connection settings
CONFIG_BANDWIDTH_WIFI_SSID="Dennis"
CONFIG_BANDWIDTH_WIFI_PASSWORD="60763312"
CONFIG_BANDWIDTH_TRANSPORT_UDP=y
# CONFIG_BANDWIDTH_TRANSPORT_TCP is not set
CONFIG_BANDWIDTH_SERVER_IP="192.168.137.1"
CONFIG_BANDWIDTH_SERVER_PORT=5001
CONFIG_BANDWIDTH_PAYLOAD_BYTES=1024
CONFIG_BANDWIDTH_FPS=100
CONFIG_BANDWIDTH_SEND_TIMEOUT_MS=100
CONFIG_BANDWIDTH_SOCKET_SNDBUF=65536
CONFIG_BANDWIDTH_SNTP_ENABLE=y
CONFIG_BANDWIDTH_SNTP_SERVER="pool.ntp.org"
CONFIG_BANDWIDTH_SNTP_SYNC_TIMEOUT_MS=15000

# USB Serial/JTAG log console
CONFIG_ESP_CONSOLE_USB_SERIAL_JTAG=y

# Project partition table
CONFIG_PARTITION_TABLE_CUSTOM=y
CONFIG_PARTITION_TABLE_CUSTOM_FILENAME="partitions.csv"
```

## esp32s3-bandwidth-sender/sdkconfig.defaults.udp_diag_1024_timeout10_psnone
```kconfig
# CPU frequency
CONFIG_ESP_DEFAULT_CPU_FREQ_MHZ_240=y

# Classic ESP32, no PSRAM for this battery/Type-C board.
CONFIG_ESPTOOLPY_FLASHSIZE_4MB=y
# CONFIG_SPIRAM is not set

CONFIG_FREERTOS_HZ=1000
CONFIG_LWIP_SNTP_MAX_SERVERS=3

CONFIG_BANDWIDTH_WIFI_SSID="Dennis"
CONFIG_BANDWIDTH_WIFI_PASSWORD="60763312"
CONFIG_BANDWIDTH_TRANSPORT_UDP=y
# CONFIG_BANDWIDTH_TRANSPORT_TCP is not set
CONFIG_BANDWIDTH_SERVER_IP="192.168.137.1"
CONFIG_BANDWIDTH_SERVER_PORT=5001
CONFIG_BANDWIDTH_PAYLOAD_BYTES=1024
CONFIG_BANDWIDTH_FPS=1000
CONFIG_BANDWIDTH_UNLIMITED_SEND=y
CONFIG_BANDWIDTH_SEND_TIMEOUT_MS=10
CONFIG_BANDWIDTH_SOCKET_SNDBUF=0
CONFIG_BANDWIDTH_WIFI_PS_NONE=y
# CONFIG_BANDWIDTH_LOG_DROPPED_FRAMES is not set
CONFIG_BANDWIDTH_SNTP_ENABLE=y
CONFIG_BANDWIDTH_SNTP_SERVER="pool.ntp.org"
CONFIG_BANDWIDTH_SNTP_SYNC_TIMEOUT_MS=60000
CONFIG_BANDWIDTH_REQUIRE_SNTP=y

CONFIG_PARTITION_TABLE_CUSTOM=y
CONFIG_PARTITION_TABLE_CUSTOM_FILENAME="partitions.csv"
```

## esp32s3-bandwidth-sender/sdkconfig.defaults.udp_max_throughput_s3_11gn_ht40_no_sntp_gate
```kconfig
# CPU frequency
CONFIG_ESP_DEFAULT_CPU_FREQ_MHZ_240=y

# ESP32-S3-PICO-1: 8MB flash + 8MB Octal PSRAM.
CONFIG_ESPTOOLPY_FLASHSIZE_8MB=y
CONFIG_SPIRAM=y
CONFIG_SPIRAM_MODE_OCT=y
CONFIG_SPIRAM_TRY_ALLOCATE_WIFI_LWIP=y

# FreeRTOS 1 ms tick
CONFIG_FREERTOS_HZ=1000

# WiFi/lwIP buffer tuning for UDP TX throughput diagnostics.
CONFIG_ESP_WIFI_STATIC_RX_BUFFER_NUM=16
CONFIG_ESP_WIFI_DYNAMIC_RX_BUFFER_NUM=64
CONFIG_ESP_WIFI_STATIC_TX_BUFFER=y
# CONFIG_ESP_WIFI_DYNAMIC_TX_BUFFER is not set
CONFIG_ESP_WIFI_STATIC_TX_BUFFER_NUM=32
CONFIG_ESP_WIFI_CACHE_TX_BUFFER_NUM=64
CONFIG_ESP_WIFI_AMPDU_TX_ENABLED=y
CONFIG_ESP_WIFI_TX_BA_WIN=12
CONFIG_ESP_WIFI_AMPDU_RX_ENABLED=y
CONFIG_ESP_WIFI_RX_BA_WIN=16
CONFIG_LWIP_TCPIP_RECVMBOX_SIZE=64
CONFIG_LWIP_UDP_RECVMBOX_SIZE=64

# UDP maximum-throughput sender connection settings.
CONFIG_BANDWIDTH_WIFI_SSID="Dennis"
CONFIG_BANDWIDTH_WIFI_PASSWORD="60763312"
CONFIG_BANDWIDTH_TRANSPORT_UDP=y
# CONFIG_BANDWIDTH_TRANSPORT_TCP is not set
CONFIG_BANDWIDTH_SERVER_IP="192.168.137.1"
CONFIG_BANDWIDTH_SERVER_PORT=5001
CONFIG_BANDWIDTH_PAYLOAD_BYTES=1024
CONFIG_BANDWIDTH_FPS=1000
CONFIG_BANDWIDTH_UNLIMITED_SEND=y
CONFIG_BANDWIDTH_SEND_TIMEOUT_MS=10
CONFIG_BANDWIDTH_SOCKET_SNDBUF=0
CONFIG_BANDWIDTH_WIFI_PS_NONE=y
# CONFIG_BANDWIDTH_WIFI_11N_ONLY is not set
CONFIG_BANDWIDTH_WIFI_11GN_ONLY=y
CONFIG_BANDWIDTH_WIFI_HT40=y
# CONFIG_BANDWIDTH_LOG_DROPPED_FRAMES is not set
CONFIG_BANDWIDTH_SNTP_ENABLE=y
CONFIG_BANDWIDTH_SNTP_SERVER="pool.ntp.org"
CONFIG_BANDWIDTH_SNTP_SYNC_TIMEOUT_MS=5000
# CONFIG_BANDWIDTH_REQUIRE_SNTP is not set

# USB Serial/JTAG log console
CONFIG_ESP_CONSOLE_USB_SERIAL_JTAG=y

# Project partition table
CONFIG_PARTITION_TABLE_CUSTOM=y
CONFIG_PARTITION_TABLE_CUSTOM_FILENAME="partitions.csv"
```
